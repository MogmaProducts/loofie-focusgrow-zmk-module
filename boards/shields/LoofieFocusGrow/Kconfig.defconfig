## boards/shields/LoofieFocusGrow/Kconfig.defconfig
```kconfig
if LOOFIE_FOCUSGROW

config ZMK_KEYBOARD_NAME
    default "FocusGrow US" if LOOFIE_FOCUSGROW_US
    default "FocusGrow ISO" if LOOFIE_FOCUSGROW_ISO
    default "Loofie FocusGrow"

config SPI
    default y

endif
```

## boards/shields/LoofieFocusGrow/Kconfig.shield
```kconfig
config LOOFIE_FOCUSGROW
    def_bool $(shields_list_contains,LoofieFocusGrow)

config LOOFIE_FOCUSGROW_US
    def_bool $(shields_list_contains,LoofieFocusGrow_US)
    select LOOFIE_FOCUSGROW

config LOOFIE_FOCUSGROW_ISO
    def_bool $(shields_list_contains,LoofieFocusGrow_ISO)
    select LOOFIE_FOCUSGROW
```
